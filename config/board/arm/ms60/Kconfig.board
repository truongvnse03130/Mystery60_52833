## config/board/arm/ms60/Kconfig.board
```kconfig
# Copyright (c) 2021 Nick Winans
# SPDX-License-Identifier: MIT

config BOARD_MS60
	bool "Mystery_60"
	depends on SOC_NRF52840_QIAA
```

## config/boards/arm/ms60/Kconfig.defconfig
```kconfig
# Copyright (c) 2020 Pete Johanson
# SPDX-License-Identifier: MIT

if BOARD_MS60

config BOARD
	default "ms60"

config ZMK_KEYBOARD_NAME
	default "Mystery 60 Ble"

if USB

config USB_NRFX
	default y

config USB_DEVICE_STACK
	default y

endif # USB

config BT_CTLR
	default BT

config ZMK_BLE
	default y

config ZMK_USB
	default y

config ZMK_EXT_POWER
	default y

config ZMK_BATTERY_VOLTAGE_DIVIDER
	default y

endif # 
```

## config/boards/arm/ms60/ms60_defconfig
```kconfig
# Copyright (c) 2021 Nick Winans
# SPDX-License-Identifier: MIT

CONFIG_SOC_SERIES_NRF52X=y
CONFIG_SOC_NRF52833_QIAA=y
CONFIG_BOARD_MS60=y

# Enable MPU
CONFIG_ARM_MPU=y

#encoder EC11
CONFIG_EC11_TRIGGER_GLOBAL_THREAD=y
CONFIG_EC11=y

# enable GPIO
CONFIG_GPIO=y

CONFIG_USE_DT_CODE_PARTITION=y
CONFIG_BUILD_OUTPUT_UF2=y

CONFIG_MPU_ALLOW_FLASH_WRITE=y
CONFIG_NVS=y
CONFIG_SETTINGS_NVS=y
CONFIG_FLASH=y
CONFIG_FLASH_PAGE_LAYOUT=y
CONFIG_FLASH_MAP=y
CONFIG_ZMK_BATTERY_REPORT_INTERVAL=1800

CONFIG_ZMK_RGB_UNDERGLOW=y
CONFIG_WS2812_STRIP=y

CONFIG_ZMK_RGB_UNDERGLOW_HUE_START=160
CONFIG_ZMK_RGB_UNDERGLOW_EFF_START=3
```

## config/west.yml
```yaml
manifest:
  remotes:
    - name: zmkfirmware
      url-base: https://github.com/zmkfirmware
    - name: lequoctrong
      url-base: https://github.com/hachachac159
    - name: zmkfirmware-infused-kim
      url-base: https://github.com/infused-kim
    - name: zmkfirmware-split-battery-report
      url-base: https://github.com/Katona/
    - name: luna
      url-base: https://github.com/pitchayath/
  projects:
    - name: zmk
    
      remote: zmkfirmware
      revision: main

      import: app/west.yml
  self:
    path: config
```
